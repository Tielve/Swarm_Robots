## build/Kconfig/boards/Kconfig.blackpill_f411ce
```kconfig
# Load board Kconfig descriptions.
osource "/home/jonathan/zephyrproject/zephyr/boards/weact/blackpill_f411ce/Kconfig.blackpill_f411ce"
```

## build/Kconfig/boards/Kconfig.defconfig
```kconfig
# Load Zephyr board defconfig descriptions.
osource "/home/jonathan/zephyrproject/zephyr/boards/weact/blackpill_f411ce/Kconfig.defconfig"
```

## build/Kconfig/boards/Kconfig.sysbuild
```kconfig
# Load Sysbuild board Kconfig descriptions.
osource "/home/jonathan/zephyrproject/zephyr/boards/weact/blackpill_f411ce/Kconfig.sysbuild"
```
